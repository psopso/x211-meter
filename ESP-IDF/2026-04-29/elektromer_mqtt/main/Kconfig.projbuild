## ESP-IDF/2026-04-29/elektromer_mqtt/main/Kconfig.projbuild
```kconfig
# put here your custom config value
menu "WIFI Configuration"
config ESP_WIFI_SSID
    string "WiFi SSID"
    default "myssid"
    help
	SSID (network name)

config ESP_WIFI_PASSWORD
    string "WiFi Password"
    default ""
    help
	WiFi password (WPA or WPA2)

config ESP_WIFI_IP
    string "WiFi IP"
    default "IP"
    help
	IP (IP address)

config ESP_WIFI_GW
    string "WiFi GW"
    default "GW"
    help
	GW (GW address)

config ESP_WIFI_NETMASK
    string "WiFi NETMASK"
    default "NETMASK"
    help
	NETMASK (NETMASK)

endmenu

menu "MQTT Configuration"
config MQTT_BROKER_URI
    string "Mqtt address"
    default ""
    help
	mqttaddress (mqtt address)

config MQTT_USERNAME
    string "Mqtt username"
    default ""
    help
	mqttusername (mqtt username)

config MQTT_PASSWORD
    string "Mqtt password"
    default ""
    help
	mqttpassword (mqtt password)

config MQTT_TOPIC_BASE
    string "Mqtt topic base"
    default "elektromer"
    help
	mqttpassword (mqtt topic base)

endmenu

menu "OTA Configuration"
config OTA_URL
    string "OTA URL"
    default ""
    help
	otaurl (ota url)

endmenu

menu "My GPIO Configuration"
config RS485_TXD_PIN
    int "RS485 TX pin"
    default 0
    help
	tx pin
config RS485_RXD_PIN
    int "RS485 RX pin"
    default 0
    help
	RX pin
config I2C_SDA_PIN
    int "I2C_SDA_PIN"
    default 0
    help
	I2C SDA
config I2C_SCL_PIN
    int "I2C_SCL_PIN"
    default 0
    help
	I2C SDA
config RS485_ENABLE_RX_PIN
    int "RS485_ENABLE_RX_PIN"
    default 0
    help
	RS485 ENABLE RX
endmenu

menu "My Debugging Options"

    config MY_DEBUG_ENABLED
        bool "Enable MQTT Debug Logger"
        default n
        help
            If set, debug messages will be routed via the registered sender (MQTT).
            If unset, log calls will compile to empty operations.

endmenu
```

## ESP-IDF/elektromer_mqtt/main/Kconfig.projbuild
```kconfig
# put here your custom config value
menu "WIFI Configuration"
config ESP_WIFI_SSID
    string "WiFi SSID"
    default "myssid"
    help
	SSID (network name)

config ESP_WIFI_PASSWORD
    string "WiFi Password"
    default ""
    help
	WiFi password (WPA or WPA2)

config ESP_WIFI_IP
    string "WiFi IP"
    default "IP"
    help
	IP (IP address)

config ESP_WIFI_GW
    string "WiFi GW"
    default "GW"
    help
	GW (GW address)

config ESP_WIFI_NETMASK
    string "WiFi NETMASK"
    default "NETMASK"
    help
	NETMASK (NETMASK)

endmenu

menu "MQTT Configuration"
config MQTT_BROKER_URI
    string "Mqtt address"
    default ""
    help
	mqttaddress (mqtt address)

config MQTT_USERNAME
    string "Mqtt username"
    default ""
    help
	mqttusername (mqtt username)

config MQTT_PASSWORD
    string "Mqtt password"
    default ""
    help
	mqttpassword (mqtt password)

config MQTT_TOPIC_BASE
    string "Mqtt topic base"
    default "elektromer"
    help
	mqttpassword (mqtt topic base)

endmenu

menu "OTA Configuration"
config OTA_URL
    string "OTA URL"
    default ""
    help
	otaurl (ota url)

endmenu
```
